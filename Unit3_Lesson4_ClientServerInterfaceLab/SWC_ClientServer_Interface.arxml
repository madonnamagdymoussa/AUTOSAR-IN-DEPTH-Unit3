AUTOSAR XML (schema 00046)
package /CS_Interface_Lab
  client server interface CS_IF_sum
    operation OP_sum
      arg IN1: type=uint16, direction=IN
      arg IN2: type=uint16, direction=IN
      arg OUT: type=uint32, direction=OUT
  application sw component type SWC1_server
    provide port PP_CS_sum: client-server-annotation=OP_sum
  application sw component type SWC2_Client
    require port RP_CS_SUM: client-server-annotation=OP_sum
